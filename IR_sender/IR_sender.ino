#include <IRremote.hpp>

#define IR_SEND_PIN 3

uint16_t rawData[] = {
  600, 12750, 3000, 8950, 500, 500,
  500, 1500, 500, 500, 500, 500,
  500, 450, 500, 500, 550, 450,
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  450, 1500, 500, 1500, 500, 1500,
  500
};

const uint16_t rawLen = sizeof(rawData) / sizeof(rawData[0]);

void sendAirconSignalOnce() {
  IrSender.sendRaw(rawData, rawLen, 38);
}

void sendAirconSignalRepeat3() {
  for (int i = 0; i < 3; i++) {
    IrSender.sendRaw(rawData, rawLen, 38);
    delay(100);
  }
}

void setup() {
  Serial.begin(115200);
  while (!Serial) {}

  IrSender.begin(IR_SEND_PIN);

  Serial.println("=== 에어컨 IR 송신 테스트 ===");
  Serial.print("rawLen = ");
  Serial.println(rawLen);
  Serial.println("1 : 1회 송신");
  Serial.println("3 : 3회 반복 송신");
}

void loop() {
  if (Serial.available()) {
    char cmd = Serial.read();

    if (cmd == '1') {
      Serial.println("[송신] 1회 송신");
      sendAirconSignalOnce();
      delay(1500);
    }
    else if (cmd == '3') {
      Serial.println("[송신] 3회 반복 송신");
      sendAirconSignalRepeat3();
      delay(1500);
    }
  }
}
